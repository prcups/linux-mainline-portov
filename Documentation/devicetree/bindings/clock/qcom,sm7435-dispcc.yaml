## Documentation/devicetree/bindings/clock/qcom,sm7435-dispcc.yaml
```yaml
# SPDX-License-Identifier: (GPL-2.0-only OR BSD-2-Clause)
%YAML 1.2
---
$id: http://devicetree.org/schemas/clock/qcom,sm7435-dispcc.yaml#
$schema: http://devicetree.org/meta-schemas/core.yaml#

title: Qualcomm Display Clock & Reset Controller on SM7435

maintainers:
  - SignKirigami <prcups@krgm.moe>

description: |
  Qualcomm display clock control module provides clocks, resets and power
  domains on SM7435.

  See also: include/dt-bindings/clock/qcom,sm7435-dispcc.h

properties:
  compatible:
    const: qcom,sm7435-dispcc

  clocks:
    items:
      - description: Board XO source
      - description: Board active XO source
      - description: Display AHB clock source from GCC
      - description: Sleep clock source
      - description: Byte clock from DSI PHY0
      - description: Pixel clock from DSI PHY0

required:
  - compatible
  - clocks
  - '#power-domain-cells'

allOf:
  - $ref: qcom,gcc.yaml#

unevaluatedProperties: false

examples:
  - |
    #include <dt-bindings/clock/qcom,rpmh.h>
    #include <dt-bindings/clock/qcom,dsi-phy-28nm.h>
    #include <dt-bindings/clock/qcom,sm7435-gcc.h>
    clock-controller@af00000 {
        compatible = "qcom,sm7435-dispcc";
        reg = <0x0af00000 0x20000>;
        clocks = <&rpmhcc RPMH_CXO_CLK>,
                 <&rpmhcc RPMH_CXO_CLK_A>,
                 <&gcc GCC_DISP_AHB_CLK>,
                 <&sleep_clk>,
                 <&dsi0_phy DSI_BYTE_PLL_CLK>,
                 <&dsi0_phy DSI_PIXEL_PLL_CLK>;
        #clock-cells = <1>;
        #reset-cells = <1>;
        #power-domain-cells = <1>;
    };
...
```

## Documentation/devicetree/bindings/clock/qcom,sm7435-gcc.yaml
```yaml
# SPDX-License-Identifier: (GPL-2.0-only OR BSD-2-Clause)
%YAML 1.2
---
$id: http://devicetree.org/schemas/clock/qcom,sm7435-gcc.yaml#
$schema: http://devicetree.org/meta-schemas/core.yaml#

title: Qualcomm Global Clock & Reset Controller on SM7435

maintainers:
  - SignKirigami <prcups@krgm.moe>

description: |
  Qualcomm global clock control module provides the clocks, resets and power
  domains on SM7435 (Qualcomm codename parrot).

  The controller is register compatible with the SM4450 one, but its clock
  tree is not: it has no GPLL3, no HLOS1 vote clocks and no video/vcodec
  clocks, and it adds the QUPV3 SE5/QSPI0 clocks of both wrappers, the camera
  sleep clock and the video AXI0 clock.  Clock IDs therefore come from
  qcom,sm7435-gcc.h and are not interchangeable with SM4450's.

  See also: include/dt-bindings/clock/qcom,sm7435-gcc.h

properties:
  compatible:
    const: qcom,sm7435-gcc

  clocks:
    items:
      - description: Board XO source
      - description: Sleep clock source
      - description: PCIe 0 pipe clock source
      - description: UFS Phy Rx symbol 0 clock source
      - description: UFS Phy Rx symbol 1 clock source
      - description: UFS Phy Tx symbol 0 clock source
      - description: USB3 Phy wrapper pipe clock source

  clock-names:
    items:
      - const: bi_tcxo
      - const: sleep_clk
      - const: pcie_0_pipe_clk
      - const: ufs_phy_rx_symbol_0_clk
      - const: ufs_phy_rx_symbol_1_clk
      - const: ufs_phy_tx_symbol_0_clk
      - const: usb3_phy_wrapper_gcc_usb30_pipe_clk

required:
  - compatible
  - clocks
  - clock-names
  - '#power-domain-cells'

allOf:
  - $ref: qcom,gcc.yaml#

unevaluatedProperties: false

examples:
  - |
    #include <dt-bindings/clock/qcom,rpmh.h>
    clock-controller@100000 {
      compatible = "qcom,sm7435-gcc";
      reg = <0x00100000 0x001f4200>;
      clocks = <&rpmhcc RPMH_CXO_CLK>, <&sleep_clk>,
               <&pcie_0_pipe_clk>, <&ufs_mem_phy 0>, <&ufs_mem_phy 1>,
               <&ufs_mem_phy 2>, <&usb_1_qmpphy>;
      #clock-cells = <1>;
      #reset-cells = <1>;
      #power-domain-cells = <1>;
    };

...
```

## Documentation/devicetree/bindings/clock/qcom,sm7435-gpucc.yaml
```yaml
# SPDX-License-Identifier: (GPL-2.0-only OR BSD-2-Clause)
%YAML 1.2
---
$id: http://devicetree.org/schemas/clock/qcom,sm7435-gpucc.yaml#
$schema: http://devicetree.org/meta-schemas/core.yaml#

title: Qualcomm SM7435 Graphics Clock, Reset and Power Controller

maintainers:
  - SignKirigami <prcups@krgm.moe>

description: |
  The graphics controller supplies clocks and resets to the GPU complex
  and exposes its CX and GX GDSCs.

  See also: include/dt-bindings/clock/qcom,sm7435-gpucc.h

allOf:
  - $ref: qcom,gcc.yaml#

properties:
  compatible:
    const: qcom,sm7435-gpucc

  clocks:
    items:
      - description: Board XO source
      - description: GPLL0 main branch source
      - description: GPLL0 divided branch source
      - description: GCC GPU SNoC DVM clock

  clock-names:
    items:
      - const: bi_tcxo
      - const: gpll0_out_main
      - const: gpll0_out_main_div
      - const: gcc_gpu_snoc_dvm_gfx_clk

  power-domains:
    items:
      - description: RPMh MX voltage domain (vendor VDD_MXA_LEVEL)
      - description: RPMh CX voltage domain

  power-domain-names:
    items:
      - const: mx
      - const: cx

  required-opps:
    items:
      - description: MX performance state for the clock controller
      - description: CX performance state for the clock controller

required:
  - compatible
  - clocks
  - clock-names
  - '#power-domain-cells'
  - power-domains
  - power-domain-names
  - required-opps

unevaluatedProperties: false
```

## Documentation/devicetree/bindings/display/msm/qcom,sm7435-mdss.yaml
```yaml
# SPDX-License-Identifier: GPL-2.0-only OR BSD-2-Clause
%YAML 1.2
---
$id: http://devicetree.org/schemas/display/msm/qcom,sm7435-mdss.yaml#
$schema: http://devicetree.org/meta-schemas/core.yaml#

title: Qualcomm SM7435 Display MDSS

maintainers:
  - SignKirigami <prcups@krgm.moe>

description:
  SM7435 MDSS containing the DPU, DSI controller and 5nm DSI PHY.

properties:
  compatible:
    const: qcom,sm7435-mdss

  reg:
    maxItems: 1

  reg-names:
    const: mdss

  interrupts:
    maxItems: 1

  interrupt-controller: true

  "#interrupt-cells":
    const: 1

  "#address-cells": true
  "#size-cells": true
  ranges: true

  clocks:
    items:
      - description: Display AHB
      - description: Display HF AXI
      - description: Display core

  clock-names:
    items:
      - const: iface
      - const: bus
      - const: core

  interconnects:
    maxItems: 3

  interconnect-names:
    maxItems: 3

patternProperties:
  "^display-controller@[0-9a-f]+$":
    type: object
    additionalProperties: true
    properties:
      compatible:
        const: qcom,sm7435-dpu

  "^dsi@[0-9a-f]+$":
    type: object
    additionalProperties: true
    properties:
      compatible:
        items:
          - const: qcom,sm7435-dsi-ctrl
          - const: qcom,mdss-dsi-ctrl

  "^phy@[0-9a-f]+$":
    type: object
    additionalProperties: true
    properties:
      compatible:
        const: qcom,sm7435-dsi-phy-5nm

required:
  - compatible

unevaluatedProperties: false
```

## Documentation/devicetree/bindings/display/panel/boe,icnl9922c.yaml
```yaml
# SPDX-License-Identifier: (GPL-2.0-only OR BSD-2-Clause)
%YAML 1.2
---
$id: http://devicetree.org/schemas/display/panel/boe,icnl9922c.yaml#
$schema: http://devicetree.org/meta-schemas/core.yaml#

title: BOE/CSOT ICNL9922C 1080x2400 DSC MIPI DSI panel

maintainers:
  - SignKirigami <prcups@krgm.moe>

allOf:
  - $ref: panel-common.yaml#

properties:
  compatible:
    enum:
      - boe,icnl9922c
      - csot,icnl9922c

  reg:
    maxItems: 1

  reset-gpios:
    maxItems: 1

  vddio-supply: true
  lab-supply: true
  ibb-supply: true
  port: true

required:
  - compatible
  - reg
  - reset-gpios
  - vddio-supply
  - lab-supply
  - ibb-supply
  - port

additionalProperties: false

examples:
  - |
    #include <dt-bindings/gpio/gpio.h>

    dsi {
        #address-cells = <1>;
        #size-cells = <0>;

        panel@0 {
            compatible = "boe,icnl9922c";
            reg = <0>;

            reset-gpios = <&tlmm 98 GPIO_ACTIVE_HIGH>;
            vddio-supply = <&panel_vddio>;
            lab-supply = <&panel_lab>;
            ibb-supply = <&panel_ibb>;

            port {
                endpoint {
                    remote-endpoint = <&dsi_out>;
                };
            };
        };
    };
```

## Documentation/devicetree/bindings/input/touchscreen/chipone,icnl9922c.yaml
```yaml
# SPDX-License-Identifier: (GPL-2.0-only OR BSD-2-Clause)
%YAML 1.2
---
$id: http://devicetree.org/schemas/input/touchscreen/chipone,icnl9922c.yaml#
$schema: http://devicetree.org/meta-schemas/core.yaml#

title: Chipone ICNL9922C SPI touchscreen controller

maintainers:
  - SignKirigami <prcups@krgm.moe>

description: |
  The controller uses the Chipone TCS protocol over mode 0 SPI. Firmware is
  downloaded into volatile SRAM. The firmware must match the panel assembly.

allOf:
  - $ref: touchscreen.yaml#
  - $ref: /schemas/spi/spi-peripheral-props.yaml#

properties:
  compatible:
    const: chipone,icnl9922c

  reg:
    maxItems: 1

  spi-max-frequency:
    maximum: 6000000

  interrupts:
    maxItems: 1

  reset-gpios:
    maxItems: 1

  firmware-name:
    description: Panel-specific firmware downloaded into controller SRAM.
    maxItems: 1

required:
  - compatible
  - reg
  - spi-max-frequency
  - interrupts
  - reset-gpios
  - firmware-name

unevaluatedProperties: false

examples:
  - |
    #include <dt-bindings/gpio/gpio.h>
    #include <dt-bindings/interrupt-controller/irq.h>

    spi {
        #address-cells = <1>;
        #size-cells = <0>;

        touchscreen@0 {
            compatible = "chipone,icnl9922c";
            reg = <0>;
            spi-max-frequency = <6000000>;
            interrupt-parent = <&tlmm>;
            interrupts = <65 IRQ_TYPE_EDGE_FALLING>;
            reset-gpios = <&tlmm 131 GPIO_ACTIVE_LOW>;
            firmware-name = "boe_chipone_firmware.bin";
            touchscreen-size-x = <4320>;
            touchscreen-size-y = <9600>;
        };
    };
```

## Documentation/devicetree/bindings/interconnect/qcom,parrot-rpmh.yaml
```yaml
# SPDX-License-Identifier: (GPL-2.0 OR BSD-2-Clause)
%YAML 1.2
---
$id: http://devicetree.org/schemas/interconnect/qcom,parrot-rpmh.yaml#
$schema: http://devicetree.org/meta-schemas/core.yaml#

title: Qualcomm RPMh Network-On-Chip Interconnect on SM7435

maintainers:
  - SignKirigami <prcups@krgm.moe>

description: |
  RPMh interconnect providers on SM7435 (parrot) communicate bandwidth
  requests through Bus Clock Managers (BCMs) using the applications RSC.

properties:
  compatible:
    enum:
      - qcom,parrot-aggre1-noc
      - qcom,parrot-aggre2-noc
      - qcom,parrot-clk-virt
      - qcom,parrot-cnoc2
      - qcom,parrot-cnoc3
      - qcom,parrot-gem-noc
      - qcom,parrot-lpass-ag-noc
      - qcom,parrot-mc-virt
      - qcom,parrot-mmss-noc
      - qcom,parrot-nsp-noc
      - qcom,parrot-pcie-anoc
      - qcom,parrot-system-noc

  reg:
    maxItems: 1

  clocks:
    minItems: 1
    maxItems: 2

required:
  - compatible

allOf:
  - $ref: qcom,rpmh-common.yaml#

  - if:
      properties:
        compatible:
          contains:
            enum:
              - qcom,parrot-clk-virt
              - qcom,parrot-mc-virt
    then:
      properties:
        reg: false
    else:
      required:
        - reg

  - if:
      properties:
        compatible:
          contains:
            enum:
              - qcom,parrot-pcie-anoc
    then:
      properties:
        clocks:
          items:
            - description: PCIe AXI clock
            - description: PCIe ANOC AHB clock

  - if:
      properties:
        compatible:
          contains:
            enum:
              - qcom,parrot-aggre1-noc
    then:
      properties:
        clocks:
          items:
            - description: USB3 primary AXI clock

  - if:
      properties:
        compatible:
          contains:
            enum:
              - qcom,parrot-aggre2-noc
    then:
      properties:
        clocks:
          items:
            - description: SDCC2 AHB clock

  - if:
      properties:
        compatible:
          contains:
            enum:
              - qcom,parrot-aggre1-noc
              - qcom,parrot-aggre2-noc
              - qcom,parrot-pcie-anoc
    then:
      required:
        - clocks
    else:
      properties:
        clocks: false

unevaluatedProperties: false

examples:
  - |
    #include <dt-bindings/clock/qcom,sm7435-gcc.h>

    interconnect-0 {
        compatible = "qcom,parrot-clk-virt";
        #interconnect-cells = <1>;
        qcom,bcm-voters = <&apps_bcm_voter>;
    };

    interconnect@16e0000 {
        compatible = "qcom,parrot-aggre1-noc";
        reg = <0x016e0000 0x1c080>;
        #interconnect-cells = <1>;
        clocks = <&gcc GCC_AGGRE_USB3_PRIM_AXI_CLK>;
        qcom,bcm-voters = <&apps_bcm_voter>;
    };
...
```

## Documentation/devicetree/bindings/pinctrl/qcom,sm7435-tlmm.yaml
```yaml
# SPDX-License-Identifier: (GPL-2.0-only OR BSD-2-Clause)
%YAML 1.2
---
$id: http://devicetree.org/schemas/pinctrl/qcom,sm7435-tlmm.yaml#
$schema: http://devicetree.org/meta-schemas/core.yaml#

title: Qualcomm Technologies, Inc. SM7435 TLMM block

maintainers:
  - SignKirigami <prcups@krgm.moe>

description: |
  Top Level Mode Multiplexer pin controller in Qualcomm SM7435 SoC.

  Only the pins, the pin groups and the GPIO controller are described so
  far: the pin-function tables have not been ported yet, so the only
  function this driver offers is "gpio".

allOf:
  - $ref: /schemas/pinctrl/qcom,tlmm-common.yaml#

properties:
  compatible:
    const: qcom,sm7435-tlmm

  reg:
    maxItems: 1

  interrupts: true
  interrupt-controller: true
  "#interrupt-cells": true
  gpio-controller: true

  gpio-reserved-ranges:
    minItems: 1
    maxItems: 68

  gpio-line-names:
    maxItems: 142

  "#gpio-cells": true
  gpio-ranges: true
  wakeup-parent: true

patternProperties:
  "-state$":
    oneOf:
      - $ref: "#/$defs/qcom-sm7435-tlmm-state"
      - patternProperties:
          "-pins$":
            $ref: "#/$defs/qcom-sm7435-tlmm-state"
        additionalProperties: false

$defs:
  qcom-sm7435-tlmm-state:
    type: object
    description:
      Pinctrl node's client devices use subnodes for desired pin configuration.
      Client device subnodes use below standard properties.
    $ref: qcom,tlmm-common.yaml#/$defs/qcom-tlmm-state
    unevaluatedProperties: false

    properties:
      pins:
        description:
          List of gpio pins affected by the properties specified in this
          subnode.
        items:
          oneOf:
            - pattern: "^gpio([0-9]|[1-9][0-9]|1[0-3][0-9]|14[01])$"
            - enum: [sdc2_clk, sdc2_cmd, sdc2_data, ufs_reset]
          minItems: 1
          maxItems: 36

      function:
        description:
          Specify the alternative function to be configured for the specified
          pins.
        enum: [gpio]

    required:
      - pins

required:
  - compatible
  - reg

additionalProperties: false

examples:
  - |
    #include <dt-bindings/interrupt-controller/arm-gic.h>
    tlmm: pinctrl@f000000 {
        compatible = "qcom,sm7435-tlmm";
        reg = <0x0f000000 0x1000000>;
        gpio-controller;
        #gpio-cells = <2>;
        gpio-ranges = <&tlmm 0 0 142>;
        interrupt-controller;
        #interrupt-cells = <2>;
        interrupts = <GIC_SPI 208 IRQ_TYPE_LEVEL_HIGH>;

        gpio-wo-state {
            pins = "gpio1";
            function = "gpio";
        };

        uart-w-state {
            rx-pins {
                pins = "gpio23";
                function = "gpio";
                bias-pull-up;
            };

            tx-pins {
                pins = "gpio22";
                function = "gpio";
                bias-disable;
            };
        };
    };
...
```
